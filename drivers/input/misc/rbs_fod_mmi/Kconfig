## drivers/input/misc/rbs_fod_mmi/Kconfig
```kconfig
config RBS_FOD_MMI
	tristate "RBS FOD sensor MMI"
	default n
	help
	 Say Y here if you wish to include support for rbs fod sensor.
	 If unsure, say N.
	 To compile this driver as a module, choose M here: the
	 module will be called rbs_fod_mmi.
```

## drivers/leds/aw2033/Kconfig
```kconfig
config LEDS_AW2033
        tristate "LEDS AW2023"
        help
          Say Y to enable support for aw2033 leds.
          If unsure, say N
          This driver can also be built as a module.  If so, the module
          will be called leds_aw2033.
```

## drivers/misc/awinic/aw862x/Kconfig
```kconfig
#
# AW862X Driver
#

config AW862X_HAPTIC
        tristate "Awinic AW862X haptic driver"
        depends on I2C && INPUT_AWINIC_HAPTIC
        help
          Say Y here if you have Awinic AW862X haptic controller
          chip in your system.

          If unsure, say N.

          To compile this driver as a module, choose M here: the
          module will be called aw862x.
```

## drivers/power/bq25980_mmi_iio/Kconfig
```kconfig
config BQ25980_MMI_IIO
        tristate "BQ25980_MMI_IIO"
        default n
        help
         Say Y here if you have a mmi bq25980 iio compatible
         device connected.

         This driver can also be built as a module.  If so, the module
         will be called bq25980_mmi_iio.
```

## drivers/power/cps4019_wls_charger/Kconfig
```kconfig
menu "Qualcomm Technologies Inc Charger and Fuel Gauge support"

config CPS_WLS_CHARGER
        tristate "CPS wireless charger driver"
        depends on POWER_SUPPLY
        depends on I2C
        help
          Say Y to enable support for CPS wireless charger.

          This driver can also be built as a module.  If so, the module
          will be called cps4019_wls_charger.

endmenu
```

## drivers/power/mm8013c_fg_mmi/Kconfig
```kconfig
config MMI_MM8013C_FG
        tristate "MMI_MM8013C_FG"
        default n
        help
         Say Y here if you have a mmi mm8013c fg compatible
         device connected.

         This driver can also be built as a module.  If so, the module
         will be called mmi_mm8013c_fg.
```
